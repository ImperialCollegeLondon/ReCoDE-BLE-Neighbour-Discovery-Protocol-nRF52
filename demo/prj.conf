## CMakeLists.txt
```
cmake_minimum_required(VERSION 3.20.0)
find_package(Zephyr REQUIRED HINTS $ENV{ZEPHYR_BASE})

project(demo)

target_sources(app PRIVATE src/main.c src/advertiser_scanner.c src/blend.c)
```

## prj.conf
```kconfig
#
# Copyright (c) 2018 Nordic Semiconductor
#
# SPDX-License-Identifier: LicenseRef-Nordic-5-Clause
#

# Logger module
CONFIG_LOG=y
CONFIG_LOG_BACKEND_RTT=y
# Button and LED library
CONFIG_DK_LIBRARY=y

# Bluetooth LE
# STEP 1 - Include the Bluetooth LE stack in your project
CONFIG_BT=y
# STEP 2 - Set the Bluetooth LE device name
CONFIG_BT_DEVICE_NAME="NordicAdv"

# enable BLE GAP roles
CONFIG_BT_PERIPHERAL=y
CONFIG_BT_CENTRAL=y


# Enable the BLE Scan module
CONFIG_BT_SCAN=y
CONFIG_BT_SCAN_FILTER_ENABLE=y
CONFIG_BT_SCAN_MANUFACTURER_DATA_CNT=1


 #  Tx power
#CONFIG_BT_CTLR_TX_PWR_PLUS_4=y 

# Enable workqueue functionality
#CONFIG_WORKQUEUE=y

# Increase stack size for the main thread and System Workqueue
CONFIG_SYSTEM_WORKQUEUE_STACK_SIZE=2048
CONFIG_MAIN_STACK_SIZE=2048
```

## src/main.c
```c
/*
 * Copyright (c) 2023 Nordic Semiconductor ASA
 *
 * SPDX-License-Identifier: LicenseRef-Nordic-5-Clause
 * adv_only_test: 50 packets per cycle, 10 cycles in total
 * packet number is updated in manufacturer data
 */

#include <zephyr/kernel.h>
#include <zephyr/logging/log.h>

/*  Include the header file of the Bluetooth LE stack */
#include <zephyr/bluetooth/bluetooth.h>

/*  Include the header file of the BLE GAP（Generic Access Profile）*/
#include <zephyr/bluetooth/gap.h>
#include <bluetooth/scan.h>

#include <dk_buttons_and_leds.h>
#include "blend.h"
#include "advertiser_scanner.h"
LOG_MODULE_REGISTER(BLEnd_NONCONN_MAIN, LOG_LEVEL_INF);


#define RUN_STATUS_LED DK_LED1
#define RUN_LED_BLINK_INTERVAL 1000
/* Timer for BLEnd timming */
#define EPOCH_DURATION 10000		// 10 seconds
#define ADV_INTERVAL 800		// 0.625ms 500ms


int main(void)
{
	int blink_status = 0;
	int err;
	
	LOG_INF("Uni-direct BLEnd: non-connectable test \n");
    
    err = dk_leds_init();
	if (err) {
		LOG_ERR("LEDs init failed (err %d)\n", err);
		return -1;
	}
    
	
	/*Enable the Bluetooth LE stack */
	err = bt_enable(NULL);
	if (err) {
		LOG_ERR("Bluetooth init failed (err %d)\n", err);
		return -1;
	}

	LOG_INF("Bluetooth initialized\n");
    
	
	scan_init();
	adv_init(ADV_INTERVAL);
    
	blend_init(EPOCH_DURATION, ADV_INTERVAL);
	blend_start();
	
    

 

	

	for (;;) {
		dk_set_led(RUN_STATUS_LED, (++blink_status) % 2);
		k_sleep(K_MSEC(RUN_LED_BLINK_INTERVAL));
	}
}
```

## src/advertiser_scanner.c
```c
#include "blend.h"
#include "advertiser_scanner.h"


LOG_MODULE_REGISTER(BLEnd_NONCONN_ADV_SCAN, LOG_LEVEL_INF);

// Define the k_work structs here.
// This is where the memory is allocated.
struct k_work adv_work;
struct k_work adv_stop;
struct k_work scan_work;
struct k_work scan_stop;

static void adv_work_handler(struct k_work *work);
static void adv_stop_handler(struct k_work *work);


static bool parse_adv_data_cb(struct bt_data *data, void *user_data);
static void scan_filter_match(struct bt_scan_device_info *device_info,
			      struct bt_scan_filter_match *filter_match,
			      bool connectable);
static int scan_start(void);
static void scan_work_handler(struct k_work *item);
static void scan_stop_handler(struct k_work *item);
static const struct bt_le_scan_param my_scan_param = {
    .type = BT_LE_SCAN_TYPE_PASSIVE, // Use passive scanning
    .interval = BT_GAP_SCAN_SLOW_INTERVAL_1, 
    .window = BT_GAP_SCAN_SLOW_INTERVAL_1,    
    .options = BT_LE_SCAN_OPT_NONE,        // No special options, or BT_LE_SCAN_OPT_FILTER_DUPLICATE for common usage
    .timeout = 0,                          // Scan indefinitely (0 means no timeout)
};


static int broadcast_stop = 0;  // adv cycle count
/* BLE Advertising Parameters variable */
static struct bt_le_adv_param *adv_param =
	BT_LE_ADV_PARAM(BT_LE_ADV_OPT_NONE, /* No options specified */
			500, /* assign an initial value first */
			500, /* assign an initial value first */
			NULL); /* Set to NULL for undirected advertising */

/* Declare the Company identifier (Company ID) */
#define COMPANY_ID_CODE 0x0059
#define BLEND_IDENTIFIER  0xFE
typedef struct adv_mfg_data {
	uint16_t company_code; /* Company Identifier Code. */
	uint16_t blend_id; /* sequence number */
} adv_mfg_data_type;


/* Define and initialize a variable of type adv_mfg_data_type */
static adv_mfg_data_type adv_mfg_data = { COMPANY_ID_CODE, BLEND_IDENTIFIER };

/* Declare the advertising packet */
static const struct bt_data ad[] = {
	/* Set the advertising flags */
	BT_DATA_BYTES(BT_DATA_FLAGS, BT_LE_AD_NO_BREDR), // no BR/EDR support
	/* Set the advertising packet data: device name and manufacturer data */
	BT_DATA(BT_DATA_NAME_COMPLETE, DEVICE_NAME, DEVICE_NAME_LEN), 
	BT_DATA(BT_DATA_MANUFACTURER_DATA, (unsigned char *)&adv_mfg_data, sizeof(adv_mfg_data)),   

};


// Define the bt_scan_manufacturer_data struct for the filter
// It holds a pointer to your filter data and its length
static struct bt_scan_manufacturer_data mfg_filter = {
    .data = (uint8_t *)&adv_mfg_data,
    .data_len = sizeof(adv_mfg_data),
};

/**
 * @brief Starts the advertising process
 *
 * @param *work Workqueue thread for starting advertising
 */
static void adv_work_handler(struct k_work *work)
{
    int err_start;
    // adv date: ad, no scan response data
    err_start = bt_le_adv_start(adv_param, ad, ARRAY_SIZE(ad), NULL, 0);
    if (err_start) {
        LOG_ERR("Advertising failed to start (err %d)", err_start);
    } else {
        LOG_INF("Advertising started (%d times)", broadcast_stop + 1);
    }
	dk_set_led(ADVERTISE_LED, 1); // turn on the advertising LED
}

/**
 * @brief stops the advertising process
 *
 * @param *work Workqueue thread for stoping advertising
 */
static void adv_stop_handler(struct k_work *work)
{
    int err_stop;
    err_stop = bt_le_adv_stop();
    if (err_stop) {
        LOG_ERR("Advertising failed to stop (err %d)", err_stop);
    } else {
        broadcast_stop++;
       LOG_INF("Advertising stopped (%d times)", broadcast_stop);
    }
	dk_set_led(ADVERTISE_LED, 0); // turn off the advertising LED
}

/** 
 * @brief  Initializes the advertising parameters and sets up the work (starting and stopping advertising)
 * @param  adv_interval  Advertising interval in units of 0.625 milliseconds.
 *          This value is passed from main and can be set by the user to different values.
 *
 */
void adv_init(int adv_interval)
{
    adv_param->interval_max =adv_interval;
    adv_param->interval_min = adv_interval;
    k_work_init(&adv_work, adv_work_handler);
    k_work_init(&adv_stop, adv_stop_handler);
}

// parses the advertising data to extract the device name.
static bool parse_adv_data_cb(struct bt_data *data, void *user_data)
{
     char *name_buffer = (char *)user_data;

    switch (data->type) {
        case BT_DATA_NAME_SHORTENED: 
        case BT_DATA_NAME_COMPLETE:  
            // add the device name to the buffer
            if (data->data_len < MAX_DEVICE_NAME_LEN) {
                memcpy(name_buffer, data->data, data->data_len);
                name_buffer[data->data_len] = '\0'; 
            } else {
            
                memcpy(name_buffer, data->data, MAX_DEVICE_NAME_LEN - 1);
                name_buffer[MAX_DEVICE_NAME_LEN - 1] = '\0';
            }
            LOG_INF("device name: %s", name_buffer);
            return false; // stop parsing further data
        default:
            // if the data type is not name, continue parsing
            return true;
    }
}

// The callback function when a scan filter match occurs.
static void scan_filter_match(struct bt_scan_device_info *device_info,
			      struct bt_scan_filter_match *filter_match,
			      bool connectable)
{
	char addr[BT_ADDR_LE_STR_LEN];
	char device_name[MAX_DEVICE_NAME_LEN] = {0};

	bt_addr_le_to_str(device_info->recv_info->addr, addr, sizeof(addr));
	bt_data_parse(device_info->adv_data, parse_adv_data_cb, device_name);

	LOG_INF("Filters matched. Address: %s connectable: %d",
		addr, connectable);
}

// Register the scan callback
BT_SCAN_CB_INIT(scan_cb, scan_filter_match, NULL,
		NULL, NULL);

//starts the scanning process.
static int scan_start(void)
{
	int err;
	//make sure the scan is stopped before starting a new one
	err = bt_scan_stop();
    if (err == -EALREADY) {
        LOG_DBG("Scan already stopped or cancelled.");
    } 
    else if (err) {
        LOG_ERR("Failed to stop scan (err %d)", err);
        return err;
    }

	err = bt_scan_start(BT_SCAN_TYPE_SCAN_PASSIVE);
	if (err) {
		LOG_ERR("Scanning failed to start (err %d)", err);
		return err;
	}
	dk_set_led(SCAN_LED, 1); // turn on the scan LED
	LOG_INF("Scan started");
	return 0;
}

/**
 * @brief Starts the scanning process
 *
 * @param *work Workqueue thread for starting scanning
 */
static void scan_work_handler(struct k_work *item)
{
	ARG_UNUSED(item);

	(void)scan_start();
}

/**
 * @brief Starts the scanning process
 *
 * @param *work Workqueue thread for stopping scanning
 */
static void scan_stop_handler(struct k_work *item)
{
	ARG_UNUSED(item);
    int err;
    err = bt_scan_stop();
    if (err == -EALREADY) {
        LOG_DBG("Scan already stopped or cancelled.");
    } 
    else if (err) {
        LOG_ERR("Failed to stop scan (err %d)", err);
        return;
    }
	dk_set_led(SCAN_LED, 0); // turn off the scan LED
    LOG_INF("scan stopped");
}

// Initializes the scan module.
// Sets up the scan parameters and registers the scan callback.
void scan_init(void)
{
	int err;
	uint8_t filter_mode = 0;
	struct bt_scan_init_param scan_init = {
		.scan_param = &my_scan_param,
		.connect_if_match = false,
	};

	bt_scan_init(&scan_init);
	bt_scan_cb_register(&scan_cb);
	bt_scan_filter_remove_all();

	err = bt_scan_filter_add(BT_SCAN_FILTER_TYPE_MANUFACTURER_DATA,&mfg_filter );
	if (err) {
		LOG_ERR("filter cannot be added (err %d", err);
		return;
	}
	filter_mode |= BT_SCAN_MANUFACTURER_DATA_FILTER;

	err = bt_scan_filter_enable(filter_mode, false);
	if (err) {
		LOG_ERR("Filters cannot be turned on (err %d)", err);
		return;
	}

	k_work_init(&scan_work, scan_work_handler);
    k_work_init(&scan_stop, scan_stop_handler);
	LOG_INF("Scan module initialized");
}
```

## src/advertiser_scanner.h
```c
#ifndef ADV_SCAN_NONCONN
#define ADV_SCAN_NONCONN

#include <zephyr/kernel.h>
#include <zephyr/logging/log.h>

/*  Include the header file of the Bluetooth LE stack */
#include <zephyr/bluetooth/bluetooth.h>

/*  Include the header file of the BLE GAP（Generic Access Profile）*/
#include <zephyr/bluetooth/gap.h>
#include <bluetooth/scan.h>

#include <dk_buttons_and_leds.h>

#define MAX_DEVICE_NAME_LEN 30
#define DEVICE_NAME CONFIG_BT_DEVICE_NAME
#define DEVICE_NAME_LEN (sizeof(DEVICE_NAME) - 1)
// Declare the k_work structs as 'extern'.
// This tells the compiler that these variables exist, but their
// memory is allocated (defined) in another .c file.
extern struct k_work adv_work;
extern struct k_work adv_stop;
extern struct k_work scan_work;
extern struct k_work scan_stop;

void adv_init(int adv_interval);
void scan_init(void);



#define SCAN_LED DK_LED2
#define ADVERTISE_LED DK_LED3


#endif
```

## src/blend.c
```c
#include "blend.h"
#include "advertiser_scanner.h"

LOG_MODULE_REGISTER(BLEnd_NONCONN_BLEND, LOG_LEVEL_INF);
static int epoch_period,adv_duration, scan_duration;
/* timer and workqueue handlers
    * These handlers are used to manage the timing of advertising and scanning operations.
    * The epoch timer triggers the start of a new epoch, while the adv and scan timers handle
    * the duration of advertising and scanning respectively.
*/
static void epoch_timer_handler(struct k_timer *timer_id);
static void adv_timeout_timer_handler(struct k_timer *timer_id);
static void scan_timeout_timer_handler(struct k_timer *timer_id);

K_TIMER_DEFINE(epoch_timer, epoch_timer_handler, NULL);
K_TIMER_DEFINE(adv_timeout_timer, adv_timeout_timer_handler, NULL);
K_TIMER_DEFINE(scan_timeout_timer, scan_timeout_timer_handler, NULL);

/**
 * @brief Handler for the advertising timeout timer
 *
 * This function is called when the advertising timeout timer expires. It stops the advertising process
 * and starts the scan process.
 *
 * @param timer_id Pointer to the timer that triggered this handler
 */
static void adv_timeout_timer_handler(struct k_timer *timer_id)
{
    LOG_INF(" enter adv_timeout_timer_handler");
	// Stop advertising after broadcasting is done
   k_work_submit(&adv_stop);
   
}

/**
 * @brief Handler for the scan timeout timer
 *
 * This function is called when the scan timeout timer expires. It stops the scanning process
 * and starts the advertising process.
 *
 * @param timer_id Pointer to the timer that triggered this handler
 */
static void scan_timeout_timer_handler(struct k_timer *timer_id)
{
	LOG_INF(" enter scan_timeout_timer_handler");
	k_work_submit(&scan_stop);
	k_work_submit(&adv_work);
	k_timer_start(&adv_timeout_timer, K_MSEC(adv_duration), K_NO_WAIT);
    LOG_INF("adv timeout timer started");
}

/**
 * @brief Handler for the epoch timer
 *
 * This function is called when the epoch timer expires. It starts the scanning process
 * and sets up the scan timeout timer.
 *
 * @param timer_id Pointer to the timer that triggered this handler
 */
static void epoch_timer_handler(struct k_timer *timer_id)
{
    LOG_INF(" enter epoch_timer_handler");
       k_work_submit(&scan_work);
	   k_timer_start(&scan_timeout_timer, K_MSEC(scan_duration), K_NO_WAIT);
       LOG_INF("scan timeout timer started");
}

/**
 * @brief Initializes the BLEnd module
 *
 * @param epoch_duration Duration of the epoch in milliseconds
 * @param adv_interval Advertising interval in 0.625 milliseconds
 */
void blend_init(int epoch_duration, int adv_interval)
{
    int adv_interval_count;
    epoch_period = epoch_duration;
    scan_duration = adv_interval* 0.625 +10 + 5;	//one adv_interval + 10ms random delay + 5ms for one advertising packet length
    adv_interval_count = (epoch_duration/2 - scan_duration)/(adv_interval* 0.625 +5);   //an average random delay of 5ms
    adv_interval_count += 1;    //one "incomplete" interval
    adv_duration = adv_interval_count * (adv_interval * 0.625 +5) + 15 ; // 15 ms for the last beacon's transmission 
    LOG_INF("BLEnd init: epoch_period %d ms, adv_duration %d ms, scan_duration %d ms", epoch_period, adv_duration, scan_duration);
}

/**
 * @brief Starts the BLEnd module
 *
 * This function starts the epoch timer, which triggers the start of the BLEnd process.
 */
void blend_start(void)
{
    k_timer_start(&epoch_timer, K_NO_WAIT, K_MSEC(epoch_period));
    LOG_INF("BLEnd start");
}
```

## src/blend.h
```c
#ifndef BLEND_NONCONN
#define BLEND_NONCONN

#include <zephyr/kernel.h>
#include <zephyr/logging/log.h>

/*  Include the header file of the Bluetooth LE stack */
#include <zephyr/bluetooth/bluetooth.h>

/*  Include the header file of the BLE GAP（Generic Access Profile）*/
#include <zephyr/bluetooth/gap.h>
#include <bluetooth/scan.h>

#include <dk_buttons_and_leds.h>
void blend_init(int epoch_duration, int adv_interval);
void blend_start(void);






#endif
```
