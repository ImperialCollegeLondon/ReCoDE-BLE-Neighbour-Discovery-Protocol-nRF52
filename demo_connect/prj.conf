## CMakeLists.txt
```
cmake_minimum_required(VERSION 3.20.0)
find_package(Zephyr REQUIRED HINTS $ENV{ZEPHYR_BASE})

project(demo)

target_sources(app PRIVATE src/main.c src/advertiser_scanner.c src/blend.c src/my_lbs.c src/my_lbs_client.c)
```

## prj.conf
```kconfig
#
# Copyright (c) 2018 Nordic Semiconductor
#
# SPDX-License-Identifier: LicenseRef-Nordic-5-Clause
#

# Logger module
CONFIG_LOG=y
CONFIG_LOG_BACKEND_RTT=y

# Button and LED library
CONFIG_DK_LIBRARY=y

# Bluetooth LE
# Include the Bluetooth LE stack in your project
CONFIG_BT=y
# Set the Bluetooth LE device name
CONFIG_BT_DEVICE_NAME="my_LBS"

# enable BLE GAP roles
CONFIG_BT_PERIPHERAL=y
CONFIG_BT_CENTRAL=y
CONFIG_BT_MAX_CONN=1

CONFIG_BT_GATT_CLIENT=y
CONFIG_BT_GATT_DM=y
CONFIG_HEAP_MEM_POOL_SIZE=2048
# Enable the BLE Scan module: one maunfacturer data filter
CONFIG_BT_SCAN=y
CONFIG_BT_SCAN_FILTER_ENABLE=y
CONFIG_BT_SCAN_MANUFACTURER_DATA_CNT=1


# Increase stack size for the main thread and System Workqueue
CONFIG_SYSTEM_WORKQUEUE_STACK_SIZE=2048
CONFIG_MAIN_STACK_SIZE=2048
```

## src/main.c
```c
/*
 * Copyright (c) 2023 Nordic Semiconductor ASA
 *
 * SPDX-License-Identifier: LicenseRef-Nordic-5-Clause
 * adv_only_test: 50 packets per cycle, 10 cycles in total
 * packet number is updated in manufacturer data
 */

#include <zephyr/kernel.h>
#include <zephyr/logging/log.h>

/*  Include the header file of the Bluetooth LE stack */
#include <zephyr/bluetooth/bluetooth.h>

/*  Include the header file of the BLE GAP（Generic Access Profile）*/
#include <zephyr/bluetooth/gap.h>
#include <bluetooth/scan.h>

#include <dk_buttons_and_leds.h>
#include "blend.h"
#include "advertiser_scanner.h"
#include "my_lbs.h"
#include "my_lbs_client.h"
#include <bluetooth/gatt_dm.h>
LOG_MODULE_REGISTER(BLEnd_CONN_MAIN, LOG_LEVEL_INF);



#define CONN_LED_PERIPHERAL DK_LED1
#define CONN_LED_CENTRAL DK_LED4
#define USER_BUTTON DK_BTN1_MSK
/* Timer for BLEnd timming */
#define EPOCH_DURATION 10000		// 10 seconds
#define ADV_INTERVAL 800		// 0.625ms 500ms

static bool app_button_state;
static struct bt_conn *default_conn = NULL;
static struct bt_my_lbs bt_my_lbs;
static struct my_lbs_client bt_my_client;

/* Define the application callback function for reading the state of the button */
static bool app_button_cb(void)
{
	return app_button_state;
}

/* Declare a varaible app_callbacks of type my_lbs_cb and initiate its members to the applications call back functions  */
static struct my_lbs_cb app_callbacks = {
	.button_cb = app_button_cb,
};

static void button_changed(uint32_t button_state, uint32_t has_changed)
{
	if (has_changed & USER_BUTTON) {
		uint32_t user_button_state = button_state & USER_BUTTON;
		/*  Send indication on a button press */
		my_lbs_send_button_state_indicate(user_button_state);
		app_button_state = user_button_state ? true : false;
	}
}


static void my_lbs_indicate_cb(struct my_lbs_client *my_lbs_c,
				      const struct my_lbs_client_button_state *meas,
				      int err)
{
	if (err) {
		LOG_ERR("Error during receiving LBS button indication, err: %d\n",
			err);
		return;
	}
	LOG_INF("Received button state indication: %s",
		meas->button_state ? "Pressed" : "Released");
	if (meas->button_state) 
		dk_set_led_on(CONN_LED_PERIPHERAL);
	else 
	dk_set_led_off(CONN_LED_PERIPHERAL);
}

static void discovery_complete(struct bt_gatt_dm *dm,
			       void *context)
{
	
	int err;
	LOG_INF("Service found");

	my_lbs_client_handles_assign(dm, &bt_my_client);

	err = my_lbs_client_button_subscribe(&bt_my_client, my_lbs_indicate_cb);
	if (err) {
		printk("Could not subscribe to LBS button characteristic (err %d)\n",
		       err);
	}

	err = bt_gatt_dm_data_release(dm);
	if (err) {
		LOG_ERR("Could not release the discovery data (err %d)\n", err);
	}
}

static void discovery_service_not_found(struct bt_conn *conn,
					void *context)
{
	LOG_INF("Service not found\n");
}

static void discovery_error(struct bt_conn *conn,
			    int err,
			    void *context)
{
	LOG_ERR("Error while discovering GATT database: (%d)\n", err);
}

struct bt_gatt_dm_cb discovery_cb = {
	.completed         = discovery_complete,
	.service_not_found = discovery_service_not_found,
	.error_found       = discovery_error,
};

static void on_connected(struct bt_conn *conn, uint8_t err)
{
	int err_dm;
	struct bt_conn_info info = {0};
	if (err) {
		LOG_ERR("Connection failed (err %u)\n", err);
		bt_conn_unref(default_conn);	// Always unref if connection fails

		return;
	}
	   // This check is important for a single-connection system:
    if (default_conn) {
        LOG_WRN("Already tracking a connection, disconnecting new one: %p", (void *)conn);
        bt_conn_disconnect(conn, BT_HCI_ERR_CONN_LIMIT_EXCEEDED);
        bt_conn_unref(conn); // Unref the connection we are not taking
        return;
    }
	
	blend_stop();

	default_conn = bt_conn_ref(conn);
	err_dm = bt_conn_get_info(default_conn, &info);
	if (err_dm) {
		LOG_ERR("Failed to get connection info %d\n", err);
		return;
	}
	if (info.role == BT_CONN_ROLE_PERIPHERAL) {
			LOG_INF("Connected: BT_CONN_ROLE_PERIPHERAL\n");
		dk_set_led_on(CONN_LED_PERIPHERAL);
	}
	if (info.role == BT_CONN_ROLE_CENTRAL) {
		LOG_INF("Connected: BT_CONN_ROLE_CENTRAL\n");
		dk_set_led_on(CONN_LED_CENTRAL);
		err_dm = bt_gatt_dm_start(default_conn,
				       BT_UUID_LBS,
				       &discovery_cb,
						NULL);
		if (err_dm) {
			LOG_ERR("Discover failed (err %d)\n", err_dm);
		}
	}
	

	
}

static void on_disconnected(struct bt_conn *conn, uint8_t reason)
{
	LOG_INF("Disconnected (reason %u)\n", reason);

	dk_set_led_off( CONN_LED_CENTRAL);
	dk_set_led_off(CONN_LED_PERIPHERAL);
	bt_conn_unref(default_conn);
	default_conn = NULL;
	blend_start();
}

struct bt_conn_cb connection_callbacks = {
	.connected = on_connected,
	.disconnected = on_disconnected,
};

static int init_button(void)
{
	int err;

	err = dk_buttons_init(button_changed);
	if (err) {
		LOG_INF("Cannot init buttons (err: %d)\n", err);
	}

	return err;
}

int main(void)
{

	int err;
	
	LOG_INF("Uni-direct BLEnd: Connection + Service \n");
    
    err = dk_leds_init();
	if (err) {
		LOG_ERR("LEDs init failed (err %d)\n", err);
		return -1;
	}
	
	err = init_button();
	if (err) {
		printk("Button init failed (err %d)\n", err);
		return -1;
	}
    
	
	/*Enable the Bluetooth LE stack */
	err = bt_enable(NULL);
	if (err) {
		LOG_ERR("Bluetooth init failed (err %d)\n", err);
		return -1;
	}
	// Register the connection callbacks （advertiser）
	bt_conn_cb_register(&connection_callbacks);

	LOG_INF("Bluetooth initialized\n");
	/* Pass your application callback functions stored in app_callbacks to the MY LBS service */
	err = my_lbs_init(&app_callbacks);
	if (err) {
		printk("Failed to init LBS (err:%d)\n", err);
		return -1;
	}
    
	
	scan_init();
	adv_init(ADV_INTERVAL);
    
	blend_init(EPOCH_DURATION, ADV_INTERVAL);
	blend_start();
	
}
```

## src/advertiser_scanner.c
```c
#include "blend.h"
#include "advertiser_scanner.h"
#include "my_lbs.h"


LOG_MODULE_REGISTER(BLEnd_CONN_ADV_SCAN, LOG_LEVEL_DBG);


// Define the k_work structs here.
// This is where the memory is allocated.
struct k_work adv_work;
struct k_work adv_stop;
struct k_work scan_work;
struct k_work scan_stop;

static void adv_work_handler(struct k_work *work);
static void adv_stop_handler(struct k_work *work);


static bool parse_adv_data_cb(struct bt_data *data, void *user_data);
static void scan_filter_match(struct bt_scan_device_info *device_info,
			      struct bt_scan_filter_match *filter_match,
			      bool connectable);
static int scan_start(void);
static void scan_work_handler(struct k_work *item);
static void scan_stop_handler(struct k_work *item);
static const struct bt_le_scan_param my_scan_param = {
    .type = BT_LE_SCAN_TYPE_PASSIVE, // Use passive scanning
    .interval = BT_GAP_SCAN_SLOW_INTERVAL_1, 
    .window = BT_GAP_SCAN_SLOW_INTERVAL_1,    
    .options = BT_LE_SCAN_OPT_NONE,        // No special options, or BT_LE_SCAN_OPT_FILTER_DUPLICATE for common usage
    .timeout = 0,                          // Scan indefinitely (0 means no timeout)
};


static int broadcast_stop = 0;  // adv cycle count
/* BLE Advertising Parameters variable */
static struct bt_le_adv_param *adv_param =
	BT_LE_ADV_PARAM(BT_LE_ADV_OPT_CONNECTABLE, /* connectable */
			500, /* assign an initial value first */
			500, /* assign an initial value first */
			NULL); /* Set to NULL for undirected advertising */

/* Declare the Company identifier (Company ID) */
#define COMPANY_ID_CODE 0x0059
#define BLEND_IDENTIFIER  0xFE
typedef struct adv_mfg_data {
	uint16_t company_code; /* Company Identifier Code. */
	uint16_t blend_id; /* sequence number */
} adv_mfg_data_type;


/* Define and initialize a variable of type adv_mfg_data_type */
static adv_mfg_data_type adv_mfg_data = { COMPANY_ID_CODE, BLEND_IDENTIFIER };

/* Declare the advertising packet */
static const struct bt_data ad[] = {
	/* Set the advertising flags */
	BT_DATA_BYTES(BT_DATA_FLAGS, BT_LE_AD_NO_BREDR), // no BR/EDR support
	/* Set the advertising packet data: device name and manufacturer data */
	BT_DATA(BT_DATA_NAME_COMPLETE, DEVICE_NAME, DEVICE_NAME_LEN), 
	BT_DATA(BT_DATA_MANUFACTURER_DATA, (unsigned char *)&adv_mfg_data, sizeof(adv_mfg_data)),   

};


// Define the bt_scan_manufacturer_data struct for the filter
// It holds a pointer to your filter data and its length
static struct bt_scan_manufacturer_data mfg_filter = {
    .data = (uint8_t *)&adv_mfg_data,
    .data_len = sizeof(adv_mfg_data),
};


/**
 * @brief Starts the advertising process
 *
 * @param *work Workqueue thread for starting advertising
 */

void adv_work_handler(struct k_work *work)

{
    int err_start;
    // adv date: ad, no scan response data
    err_start = bt_le_adv_start(adv_param, ad, ARRAY_SIZE(ad), NULL, 0);
    if (err_start) {
        LOG_ERR("Advertising failed to start (err %d)", err_start);
    } else {
        LOG_DBG("Advertising started (%d times)", broadcast_stop + 1);
    }
	dk_set_led(ADVERTISE_LED, 1); // turn on the advertising LED
}

/**
 * @brief stops the advertising process
 *
 * @param *work Workqueue thread for stoping advertising
 */
void adv_stop_handler(struct k_work *work)
{
    int err_stop;
    err_stop = bt_le_adv_stop();
    if (err_stop) {
        LOG_ERR("Advertising failed to stop (err %d)", err_stop);
    } else {
        broadcast_stop++;
       LOG_DBG("Advertising stopped (%d times)", broadcast_stop);
    }
	dk_set_led(ADVERTISE_LED, 0); // turn off the advertising LED
}

/** 
 * @brief  Initializes the advertising parameters and sets up the work (starting and stopping advertising)
 * @param  adv_interval  Advertising interval in units of 0.625 milliseconds.
 *          This value is passed from main and can be set by the user to different values.
 *
 */
void adv_init(int adv_interval)
{
    adv_param->interval_max =adv_interval;
    adv_param->interval_min = adv_interval;
    k_work_init(&adv_work, adv_work_handler);
    k_work_init(&adv_stop, adv_stop_handler);
}

// parses the advertising data to extract the device name.
bool parse_adv_data_cb(struct bt_data *data, void *user_data)
{
     char *name_buffer = (char *)user_data;

    switch (data->type) {
        case BT_DATA_NAME_SHORTENED: 
        case BT_DATA_NAME_COMPLETE:  
            // add the device name to the buffer
            if (data->data_len < MAX_DEVICE_NAME_LEN) {
                memcpy(name_buffer, data->data, data->data_len);
                name_buffer[data->data_len] = '\0'; 
            } else {
            
                memcpy(name_buffer, data->data, MAX_DEVICE_NAME_LEN - 1);
                name_buffer[MAX_DEVICE_NAME_LEN - 1] = '\0';
            }
            LOG_INF("device name: %s", name_buffer);
            return false; // stop parsing further data
        default:
            // if the data type is not name, continue parsing
            return true;
    }
}

// The callback function when a scan filter match occurs.
void scan_filter_match(struct bt_scan_device_info *device_info,
			      struct bt_scan_filter_match *filter_match,
			      bool connectable)
{
	char addr[BT_ADDR_LE_STR_LEN];
	char device_name[MAX_DEVICE_NAME_LEN] = {0};

	bt_addr_le_to_str(device_info->recv_info->addr, addr, sizeof(addr));
	bt_data_parse(device_info->adv_data, parse_adv_data_cb, device_name);

	LOG_INF("Filters matched. Address: %s connectable: %d",
		addr, connectable);
}

// Register the scan callback
BT_SCAN_CB_INIT(scan_cb, scan_filter_match, NULL,
		NULL, NULL);

//starts the scanning process.
int scan_start(void)
{
	int err;
	//make sure the scan is stopped before starting a new one
	err = bt_scan_stop();
    if (err == -EALREADY) {
        LOG_DBG("Scan already stopped or cancelled.");
    } 
    else if (err) {
        LOG_ERR("Failed to stop scan (err %d)", err);
        return err;
    }

	

	err = bt_scan_start(BT_SCAN_TYPE_SCAN_PASSIVE);
	if (err) {
		LOG_ERR("Scanning failed to start (err %d)", err);
		return err;
	}
	dk_set_led(SCAN_LED, 1); // turn on the scan LED
	LOG_DBG("Scan started");
	return 0;
}
/**
 * @brief Starts the scanning process
 *
 * @param *work Workqueue thread for starting scanning
 */
void scan_work_handler(struct k_work *item)
{
	ARG_UNUSED(item);

	(void)scan_start();
}

/**
 * @brief Starts the scanning process
 *
 * @param *work Workqueue thread for stopping scanning
 */
void scan_stop_handler(struct k_work *item)
{
	ARG_UNUSED(item);
    int err;
    err = bt_scan_stop();
    if (err == -EALREADY) {
        LOG_DBG("Scan already stopped or cancelled.");
    } 
    else if (err) {
        LOG_ERR("Failed to stop scan (err %d)", err);
        return;
    }
	dk_set_led(SCAN_LED, 0); // turn off the scan LED
    LOG_DBG("scan stopped");
}

// Initializes the scan module.
// Sets up the scan parameters and registers the scan callback.
void scan_init(void)
{
	int err;
	uint8_t filter_mode = 0;
	struct bt_scan_init_param scan_init = {
		.scan_param = &my_scan_param,
		.connect_if_match = true,
	};

	bt_scan_init(&scan_init);
	bt_scan_cb_register(&scan_cb);
	bt_scan_filter_remove_all();

	err = bt_scan_filter_add(BT_SCAN_FILTER_TYPE_MANUFACTURER_DATA,&mfg_filter );
	if (err) {
		LOG_ERR("filter cannot be added (err %d", err);
		return;
	}
	filter_mode |= BT_SCAN_MANUFACTURER_DATA_FILTER;

	err = bt_scan_filter_enable(filter_mode, false);
	if (err) {
		LOG_ERR("Filters cannot be turned on (err %d)", err);
		return;
	}

	k_work_init(&scan_work, scan_work_handler);
    k_work_init(&scan_stop, scan_stop_handler);
	LOG_DBG("Scan module initialized");
}
```

## src/advertiser_scanner.h
```c
#include <zephyr/kernel.h>
#include <zephyr/logging/log.h>

/*  Include the header file of the Bluetooth LE stack */
#include <zephyr/bluetooth/bluetooth.h>

/*  Include the header file of the BLE GAP（Generic Access Profile）*/
#include <zephyr/bluetooth/gap.h>
#include <bluetooth/scan.h>

#include <dk_buttons_and_leds.h>

#define SCAN_LED DK_LED2
#define ADVERTISE_LED DK_LED3

#define MAX_DEVICE_NAME_LEN 30
#define DEVICE_NAME CONFIG_BT_DEVICE_NAME
#define DEVICE_NAME_LEN (sizeof(DEVICE_NAME) - 1)
// Declare the k_work structs as 'extern'.
// This tells the compiler that these variables exist, but their
// memory is allocated (defined) in another .c file.
extern struct k_work adv_work;
extern struct k_work adv_stop;
extern struct k_work scan_work;
extern struct k_work scan_stop;

void adv_init(int adv_interval);
void scan_init(void);
```

## src/blend.c
```c
#include "blend.h"
#include "advertiser_scanner.h"

LOG_MODULE_REGISTER(BLEnd_CONN_BLEND, LOG_LEVEL_DBG);
/* timer and workqueue handlers
    * These handlers are used to manage the timing of advertising and scanning operations.
    * The epoch timer triggers the start of a new epoch, while the adv and scan timers handle
    * the duration of advertising and scanning respectively.
*/
static void epoch_timer_handler(struct k_timer *timer_id);
static void adv_timeout_timer_handler(struct k_timer *timer_id);
static void scan_timeout_timer_handler(struct k_timer *timer_id);
K_TIMER_DEFINE(epoch_timer, epoch_timer_handler, NULL);
K_TIMER_DEFINE(adv_timeout_timer, adv_timeout_timer_handler, NULL);
K_TIMER_DEFINE(scan_timeout_timer, scan_timeout_timer_handler, NULL);


static int epoch_period,adv_duration, scan_duration;

/**
 * @brief Handler for the advertising timeout timer
 *
 * This function is called when the advertising timeout timer expires. It stops the advertising process
 * and starts the scan process.
 *
 * @param timer_id Pointer to the timer that triggered this handler
 */
void adv_timeout_timer_handler(struct k_timer *timer_id)
{
    LOG_DBG(" enter adv_timeout_timer_handler");
	// Stop advertising after broadcasting is done
   k_work_submit(&adv_stop);
   
}

/**
 * @brief Handler for the scan timeout timer
 *
 * This function is called when the scan timeout timer expires. It stops the scanning process
 * and starts the advertising process.
 *
 * @param timer_id Pointer to the timer that triggered this handler
 */
void scan_timeout_timer_handler(struct k_timer *timer_id)
{
	LOG_DBG(" enter scan_timeout_timer_handler");
	k_work_submit(&scan_stop);
	k_work_submit(&adv_work);
	k_timer_start(&adv_timeout_timer, K_MSEC(adv_duration), K_NO_WAIT);
    LOG_DBG("adv timeout timer started");
}

/**
 * @brief Handler for the epoch timer
 *
 * This function is called when the epoch timer expires. It starts the scanning process
 * and sets up the scan timeout timer.
 *
 * @param timer_id Pointer to the timer that triggered this handler
 */
void epoch_timer_handler(struct k_timer *timer_id)
{
    LOG_DBG(" enter epoch_timer_handler");
       k_work_submit(&scan_work);
	   k_timer_start(&scan_timeout_timer, K_MSEC(scan_duration), K_NO_WAIT);
       LOG_DBG("scan timeout timer started");
}

/**
 * @brief Initializes the BLEnd module
 *
 * @param epoch_duration Duration of the epoch in milliseconds
 * @param adv_interval Advertising interval in 0.625 milliseconds
 */
void blend_init(int epoch_duration, int adv_interval)
{
    int adv_interval_count;
    epoch_period = epoch_duration;
    scan_duration = adv_interval* 0.625 +10 + 5;	//one adv_interval + 10ms random delay + 5ms for one advertising packet length
    adv_interval_count = (epoch_duration/2 - scan_duration)/(adv_interval* 0.625 +5);   //an average random delay of 5ms
    adv_interval_count += 1;    //one "incomplete" interval
    adv_duration = adv_interval_count * (adv_interval * 0.625 +5) + 15 ; // 15 ms for the last beacon's transmission 
    LOG_INF("BLEnd init: epoch_period %d ms, adv_duration %d ms, scan_duration %d ms", epoch_period, adv_duration, scan_duration);
}
/**
 * @brief Starts the BLEnd module
 *
 * This function starts the epoch timer, which triggers the start of the BLEnd process.
 */
void blend_start(void)
{
        k_timer_start(&epoch_timer, K_NO_WAIT, K_MSEC(epoch_period));
        LOG_INF("BLEnd start");
}

/**
 * @brief Stops the BLEnd module
 *
 * This function stops the epoch timer and any ongoing advertising or scanning processes.
 */
void blend_stop (void)
{
        k_timer_stop(&epoch_timer);
        k_timer_stop(&adv_timeout_timer);
        k_timer_stop(&scan_timeout_timer);
        k_work_submit(&adv_stop);
        k_work_submit(&scan_stop);
        LOG_INF("BLEnd stop");
}
```

## src/blend.h
```c
#include <zephyr/kernel.h>
#include <zephyr/logging/log.h>

/*  Include the header file of the Bluetooth LE stack */
#include <zephyr/bluetooth/bluetooth.h>

/*  Include the header file of the BLE GAP（Generic Access Profile）*/
#include <zephyr/bluetooth/gap.h>
#include <bluetooth/scan.h>

#include <dk_buttons_and_leds.h>
void blend_init(int epoch_duration, int adv_interval);
void blend_start(void);
void blend_stop(void);
```

## src/my_lbs.c
```c
#include "my_lbs.h"

LOG_MODULE_DECLARE(MY_LBS);

static bool button_state;
static bool indicate_enabled;
static struct my_lbs_cb lbs_cb;

/* Define an indication parameter */
static struct bt_gatt_indicate_params ind_params;

/* Implement the configuration change callback function */
static void mylbsbc_ccc_cfg_changed(const struct bt_gatt_attr *attr, uint16_t value)
{
	indicate_enabled = (value == BT_GATT_CCC_INDICATE);
}

// This function is called when a remote device has acknowledged the indication at its host layer
static void indicate_cb(struct bt_conn *conn, struct bt_gatt_indicate_params *params, uint8_t err)
{
	LOG_DBG("Indication %s\n", err != 0U ? "fail" : "success");
}

/*  Implement the read callback function of the Button characteristic */
static ssize_t read_button(struct bt_conn *conn, const struct bt_gatt_attr *attr, void *buf,
			   uint16_t len, uint16_t offset)
{
	// get a pointer to button_state which is passed in the BT_GATT_CHARACTERISTIC() and stored in attr->user_data
	const char *value = attr->user_data;

	LOG_DBG("Attribute read, handle: %u, conn: %p", attr->handle, (void *)conn);

	if (lbs_cb.button_cb) {
		// Call the application callback function to update the get the current value of the button
		button_state = lbs_cb.button_cb();
		return bt_gatt_attr_read(conn, attr, buf, len, offset, value, sizeof(*value));
	}

	return 0;
}

/*  Service Declaration */
/*  Create and add the MY LBS service to the Bluetooth LE stack */
BT_GATT_SERVICE_DEFINE(my_lbs_svc, BT_GATT_PRIMARY_SERVICE(BT_UUID_LBS),
		       /*  Create and add the Button characteristic */
		       	BT_GATT_CHARACTERISTIC(BT_UUID_LBS_BUTTON,
			       BT_GATT_CHRC_READ | BT_GATT_CHRC_INDICATE,
			       BT_GATT_PERM_READ, read_button, NULL,
			       &button_state),
				BT_GATT_CCC(mylbsbc_ccc_cfg_changed, BT_GATT_PERM_READ | BT_GATT_PERM_WRITE),

);
/* A function to register application callbacks for the LED and Button characteristics  */
int my_lbs_init(struct my_lbs_cb *callbacks)
{
	if (callbacks) {
		lbs_cb.button_cb = callbacks->button_cb;
	}

	return 0;
}

/* Define the function to send indications */
int my_lbs_send_button_state_indicate(bool button_state)
{
	if (!indicate_enabled) {
		return -EACCES;
	}
	ind_params.attr = &my_lbs_svc.attrs[2];
	ind_params.func = indicate_cb; // A remote device has ACKed at its host layer (ATT ACK)
	ind_params.destroy = NULL;
	ind_params.data = &button_state;
	ind_params.len = sizeof(button_state);
	return bt_gatt_indicate(NULL, &ind_params);
}
```

## src/my_lbs.h
```c
#ifndef MY_LBS_H_
#define MY_LBS_H_

#include <zephyr/types.h>
#include <stddef.h>
#include <string.h>
#include <errno.h>
#include <zephyr/sys/byteorder.h>
#include <zephyr/kernel.h>

#include <zephyr/bluetooth/bluetooth.h>
#include <zephyr/bluetooth/hci.h>
#include <zephyr/bluetooth/conn.h>
#include <zephyr/bluetooth/uuid.h>
#include <zephyr/bluetooth/gatt.h>
#include <zephyr/logging/log.h>

/** @brief LBS Service UUID. */
#define BT_UUID_LBS_VAL \
	BT_UUID_128_ENCODE(0x00001523, 0x1212, 0xefde, 0x1523, 0x785feabcd123)
	
/** @brief Button Characteristic UUID. */
#define BT_UUID_LBS_BUTTON_VAL \
	BT_UUID_128_ENCODE(0x00001524, 0x1212, 0xefde, 0x1523, 0x785feabcd123)
	

#define BT_UUID_LBS BT_UUID_DECLARE_128(BT_UUID_LBS_VAL)
#define BT_UUID_LBS_BUTTON BT_UUID_DECLARE_128(BT_UUID_LBS_BUTTON_VAL)



/** @brief Callback type for when the button state is pulled. */
typedef bool (*button_cb_t)(void);

/** @brief Callback struct used by the LBS Service. */
struct my_lbs_cb {
	/** Button read callback. */
	button_cb_t button_cb;
};

/** @brief my lbs structure. */
struct bt_my_lbs {
	/** lbs Characteristic handle. */
	uint16_t char_handle;

	/** GATT read parameters for the Characteristic. */
	struct bt_gatt_read_params read_params;

	/** callback structure. */
	struct my_lbs_cb *cb;

	/** Connection object. */
	struct bt_conn *conn;
};


/** @brief Initialize the LBS Service.
 *
 * This function registers application callback functions with the My LBS
 * Service
 *
 * @param[in] callbacks Struct containing pointers to callback functions
 *			used by the service. This pointer can be NULL
 *			if no callback functions are defined.
 *
 *
 * @retval 0 If the operation was successful.
 *           Otherwise, a (negative) error code is returned.
 */
int my_lbs_init(struct my_lbs_cb *callbacks);

/** @brief Send the button state as indication.
 *
 * This function sends a binary state, typically the state of a
 * button, to all connected peers.
 *
 * @param[in] button_state The state of the button.
 *
 * @retval 0 If the operation was successful.
 *           Otherwise, a (negative) error code is returned.
 */
int my_lbs_send_button_state_indicate(bool button_state);

#endif 
```

## src/my_lbs_client.c
```c
#include "my_lbs_client.h"
#include "my_lbs.h"
#include <zephyr/sys/util.h>
#include <zephyr/sys/byteorder.h>

#include <zephyr/logging/log.h>

LOG_MODULE_REGISTER(my_lbs_client, LOG_LEVEL_INF);

#define INDICATE_ENABLED BIT(0)

static void my_lbs_reinit(struct my_lbs_client *my_lbs_c)
{
	my_lbs_c->conn = NULL;
    my_lbs_c->button_char.handle = 0;
    my_lbs_c->button_char.ccc_handle = 0;
    my_lbs_c->button_char.indicate_cb = NULL;
    my_lbs_c->state = ATOMIC_INIT(0);
}

/**
 * @brief Parse the data received from the LBS measurement characteristic.
 *
 * @param lbs_measurement Pointer to the structure where parsed data will be stored.
 * @param data Pointer to the data received from the characteristic.
 * @param length Length of the received data.
 *
 * @return 0 on success, negative error code on failure.
 */
static int my_lbs_button_data_parse(struct my_lbs_client_button_state *lbs_state,
				      const uint8_t *data, uint16_t length)
{
	if (!data || length < sizeof(lbs_state->button_state)) {
		LOG_ERR("Invalid data received");
		return -EINVAL;
	}

	lbs_state->button_state = data[0] ? true : false;

	return 0;
}

/**
 * @brief Callback function for handling indications from the LBS button characteristic.
 *
 * @param conn Pointer to the Bluetooth connection.
 * @param params Pointer to the subscription parameters.
 * @param data Pointer to the data received from the characteristic.
 * @param length Length of the received data.
 *
 * @return BT_GATT_ITER_CONTINUE to continue receiving indications, or BT_GATT_ITER_STOP to stop.
 */
static uint8_t my_lbs_button_indicate(struct bt_conn *conn,
					 struct bt_gatt_subscribe_params *params,
					 const void *data, uint16_t length)
{
	int err;
	struct my_lbs_client *my_lbs_c;
	struct my_lbs_client_button_state lbs_button_state;

	my_lbs_c = CONTAINER_OF(params, struct my_lbs_client, button_char.indicate_params);

	if (!data) {
		atomic_clear_bit(&my_lbs_c->state, INDICATE_ENABLED);
		LOG_DBG("[UNSUBSCRIBE] from LBS button characterictic");

		return BT_GATT_ITER_STOP;
	}

	err = my_lbs_button_data_parse(&lbs_button_state, data, length);


	if (my_lbs_c->button_char.indicate_cb) {
		my_lbs_c->button_char.indicate_cb(my_lbs_c, &lbs_button_state, err);
	}
	return BT_GATT_ITER_CONTINUE;
}

/**
 * @brief Subscribe to the LBS-BUTTON characteristic for indications.
 * 
 * * This function writes CCC descriptor of the LBS-BUTTON characteristic
 * to enable indication.
 * @param my_lbs_c Pointer to the LBS client structure.
 * @param indicate_cb Callback function to handle received indications.
 *
 * @return 0 on success, negative error code on failure.
 */
int my_lbs_client_button_subscribe(struct  my_lbs_client *my_lbs_c,
					my_lbs_client_indicate_cb indicate_cb)
{
	int err;
	struct bt_gatt_subscribe_params *params = &my_lbs_c->button_char.indicate_params;

	if (!my_lbs_c || !indicate_cb) {
		return -EINVAL;
	}

	if (atomic_test_and_set_bit(&my_lbs_c->state, INDICATE_ENABLED)) {
		LOG_INF("LBS-BUTTON characterisic indication already enabled.");
		// return -EALREADY;
	}
    my_lbs_c->button_char.indicate_cb = indicate_cb;
    params->ccc_handle = my_lbs_c->button_char.ccc_handle;
    params->value_handle = my_lbs_c->button_char.handle;
    params->value= BT_GATT_CCC_INDICATE;
    params->notify = my_lbs_button_indicate;

	atomic_set_bit(params->flags, BT_GATT_SUBSCRIBE_FLAG_VOLATILE);

	err = bt_gatt_subscribe(my_lbs_c->conn, params);
	if (err) {
		atomic_clear_bit(&my_lbs_c->state, INDICATE_ENABLED);
		LOG_ERR("Subscribe to characteristic failed");
	} else {
		LOG_DBG("Subscribed to  LBS-BUTTON characteristic");
	}

	return err;
}

/**
 * @brief Unsubscribe from the LBS-BUTTON characteristic.
 *
 * @param my_lbs_c Pointer to the LBS client structure.
 *
 * @return 0 on success, negative error code on failure.
 */
int bt_hrs_client_button_unsubscribe(struct my_lbs_client *my_lbs_c)
{
	int err;

	if (!my_lbs_c) {
		return -EINVAL;
	}

	if (!atomic_test_bit(&my_lbs_c->state, INDICATE_ENABLED)) {
		return -EFAULT;
	}

	err = bt_gatt_unsubscribe(my_lbs_c->conn, &my_lbs_c->button_char.indicate_params);
	if (err) {
		LOG_ERR("Unsubscribing from LBS-BUTTON characteristic failed, err: %d",
			err);
	} else {
		atomic_clear_bit(&my_lbs_c->state, INDICATE_ENABLED);
		LOG_DBG("Unsubscribed from LBS-BUTTON characteristic");
	}

	return err;
}

/**
 * @brief Assign GATT handles for the LBS client from the discovered GATT database.
 *
 * @param dm Pointer to the GATT discovery manager.
 * @param my_lbs_c Pointer to the LBS client structure.
 *
 * @return 0 on success, negative error code on failure.
 */
int my_lbs_client_handles_assign(struct bt_gatt_dm *dm, struct my_lbs_client *my_lbs_c)
{
	// Get the service and characteristic attributes from the GATT discovery manager
	const struct bt_gatt_dm_attr *gatt_service_attr =
			bt_gatt_dm_service_get(dm);
	// Get the service value from the attribute
	const struct bt_gatt_service_val *gatt_service =
			bt_gatt_dm_attr_service_val(gatt_service_attr);
	const struct bt_gatt_dm_attr *gatt_chrc;
	const struct bt_gatt_dm_attr *gatt_desc;

	if (!dm || !my_lbs_c) {
		return -EINVAL;
	}

	if (bt_uuid_cmp(gatt_service->uuid, BT_UUID_LBS)) {
		return -ENOTSUP;
	}
	LOG_DBG("Getting handles from my_lbs service.");

	my_lbs_reinit(my_lbs_c);

	// find LBS-BUTTON characteristic 
	gatt_chrc = bt_gatt_dm_char_by_uuid(dm, BT_UUID_LBS_BUTTON);
	if (!gatt_chrc) {
		LOG_ERR("No LBS characteristic found.");
		return -EINVAL;
	}

	
	gatt_desc = bt_gatt_dm_desc_by_uuid(dm, gatt_chrc,
					    BT_UUID_LBS_BUTTON);
	if (!gatt_desc) {
		LOG_ERR("No LBS-BUTTON characteristic value found.");
		return -EINVAL;
	}
	
	my_lbs_c->button_char.handle = gatt_desc->handle;

	
	gatt_desc = bt_gatt_dm_desc_by_uuid(dm, gatt_chrc, BT_UUID_GATT_CCC);
	if (!gatt_desc) {
		LOG_ERR("No LBS-BUTTON CCC descriptor found.");
		return -EINVAL;
	}

	my_lbs_c->button_char.ccc_handle = gatt_desc->handle;

	LOG_DBG("LBS-BUTTON characteristic found");

	
	/* Finally - save connection object */
	my_lbs_c->conn = bt_gatt_dm_conn_get(dm);

	return 0;
}

/*
 * @brief Initialize the LBS client.	
*/
int my_lbs_client_init(struct my_lbs_client *my_lbs_c)
{
	if (!my_lbs_c) {
		return -EINVAL;
	}

	memset(my_lbs_c, 0, sizeof(*my_lbs_c));

	return 0;
}
```

## src/my_lbs_client.h
```c
#ifndef MY_LBS_CLIENT_H_
#define MY_LBS_CLIENT_H_

#include <zephyr/bluetooth/conn.h>
#include <bluetooth/gatt_dm.h>
#include <zephyr/bluetooth/gatt.h>

#include <zephyr/sys/atomic.h>


/** @brief Data structure of the lbs characteristic.
 */
struct my_lbs_client_button_state {
	 bool button_state; /**< Button state */
};

/* Helper forward structure declaration representing Heart Rate Service Client instance.
 * Needed for callback declaration that are using instance structure as argument.
 */
struct my_lbs_client;

/** @brief indication callback.
 *
 * This function is called every time the client receives a indication
 *
 * @param[in] my_lbs_client  Service Client instance.
 * @param[in] meas  received data.
 * @param[in] err 0 if the notification is valid.
 *                Otherwise, contains a (negative) error code.
 */
typedef void (*my_lbs_client_indicate_cb)(struct my_lbs_client *my_lbs_c,
					const struct my_lbs_client_button_state *meas,
					int err);


/** @brief my lbs button characteristic structure.
 */
struct my_lbs_client_button {
	/** Value handle. */
	uint16_t handle;

	/** Handle of the characteristic CCC descriptor. */
	uint16_t ccc_handle;

	/** GATT subscribe parameters for indicate. */
	struct bt_gatt_subscribe_params indicate_params;

	/** Indicate callback. */
	my_lbs_client_indicate_cb indicate_cb;
};


/** @brief LBS Client instance structure.
 *        This structure contains status information for the client.
 */
struct my_lbs_client {
	/** Connection object. */
	struct bt_conn *conn;

	/** LBS button characteristic. */
	struct my_lbs_client_button button_char;


	/** Internal state. */
	atomic_t state;
};



/** @brief Function for initializing the LBS Client.
 *
 * @param[in, out] my_lbs_c LBS Client instance. This structure must be
 *                       supplied by the application. It is initialized by
 *                       this function and will later be used to identify
 *                       this particular client instance.
 *
 * @retval 0 If the client was initialized successfully.
 *           Otherwise, a (negative) error code is returned.
 */
int my_lbs_client_init(struct my_lbs_client *my_lbs_c);




 /** @brief Subscribe to the LBS measurement characteristic for indications.
 *
 * @param my_lbs_c Pointer to the LBS client structure.
 * @param indicate_cb Callback function to handle received indications.
 *
 * @return 0 on success, negative error code on failure.
 */
int my_lbs_client_button_subscribe(struct  my_lbs_client *my_lbs_c,
					my_lbs_client_indicate_cb indicate_cb);

					
/**
 * @brief Unsubscribe from the LBS-BUTTON characteristic.
 *
 * @param my_lbs_c Pointer to the LBS client structure.
 *
 * @return 0 on success, negative error code on failure.
 */
int my_lbs_client_button_unsubscribe(struct my_lbs_client *my_lbs_c);


/**
 * @brief Assign GATT handles for the LBS client from the discovered GATT database.
 *
 * @param dm Pointer to the GATT discovery manager.
 * @param my_lbs_c Pointer to the LBS client structure.
 *
 * @return 0 on success, negative error code on failure.
 */
int my_lbs_client_handles_assign(struct bt_gatt_dm *dm, struct my_lbs_client *my_lbs_c);

#endif 
```
